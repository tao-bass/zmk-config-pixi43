## config/west.yml
```yaml
manifest:
  remotes:
    - name: zmkfirmware
      url-base: https://github.com/zmkfirmware
    - name: keebJP
      url-base: https://github.com/keebJP
  projects:
    - name: zmk
      remote: zmkfirmware
      revision: d86523961121d5828479e099684128f646062f85  # ZMK Studio対応の安定した地点
      import: app/west.yml
    - name: zmk-pmw3610-driver
      remote: keebJP
      revision: main
  self:
    path: config
```
